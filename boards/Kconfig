## boards/Kconfig
```kconfig
# SPDX-License-Identifier: Apache-2.0
# Copyright (c) 2019 Martin Jäger (Libre Solar)

#
# Invisible (board-specific) Kconfig symbols
#

config CONTROL_FREQUENCY
	int
	default 10
	help
	  Main control function frequency (Hz)

	  Frequencies higher than 10 Hz caused issues with MPPT control during lab test with
	  PV simulator. Might be different with actual solar panel.

config LIBRE_SOLAR_TYPE_ID
    int
    help
      Numeric Libre Solar hardware type ID

config HS_MOSFET_FAIL_SAFE_PROTECTION
    bool
    default y
    help
      If enabled, the DC/DC control function will will detect if the high-side MOSFET has failed
      short and trip the fuse by switching the low-side MOSFET continuously on. This will prevent
      accidental overcharging of the battery.

#
# Visible (user-configurable) Kconfig symbols
#

choice
    prompt "High-voltage terminal"
    depends on $(dt_compat_enabled,dcdc)
    help
      Select the device connected to the high-voltage
      side terminal of the DC/DC converter.

    config HV_TERMINAL_SOLAR
        bool "Solar panel"

    config HV_TERMINAL_NANOGRID
        bool "DC nanogrid"

    config HV_TERMINAL_GENERATOR
        bool "DC generator, e.g. wind turbine"

    config HV_TERMINAL_BATTERY
        bool "Battery, e.g. electric bicycle"
endchoice


choice
    prompt "Low-voltage terminal"
    help
      Select the device connected to the low-voltage side
      of the charge controller (usually battery terminal).

    config LV_TERMINAL_BATTERY
        depends on !HV_TERMINAL_BATTERY
        bool "Battery 12V/24V"

    config LV_TERMINAL_SOLAR
        depends on HV_TERMINAL_BATTERY || HV_TERMINAL_NANOGRID
        bool "Solar panel"
endchoice


choice
    prompt "PWM terminal"
    depends on $(dt_node_has_bool_prop,/outputs/pwm_switch,kconfig-flag)
    help
      Select the device connected to the PWM switch (currently
      only solar panel possible)

    config PWM_TERMINAL_SOLAR
        depends on LV_TERMINAL_BATTERY && !HV_TERMINAL_SOLAR
        bool "Solar panel"
endchoice


menu "Battery configuration"

choice
    prompt "Default battery cell type"
    default BAT_DEFAULT_TYPE_GEL
    help
      Select the type of the single cells inside the battery
      to determine voltage set points. Total voltage set points
      are multiplied with the selected number of cells.

    config BAT_DEFAULT_TYPE_FLOODED
        bool "Flooded (wet) lead-acid"

    config BAT_DEFAULT_TYPE_GEL
        bool "VRLA gel, maintainance-free"

    config BAT_DEFAULT_TYPE_AGM
        bool "AGM, maintainance-free"

    config BAT_DEFAULT_TYPE_LFP
        bool "LiFePO4 Li-ion, 3.3V nominal"

    config BAT_DEFAULT_TYPE_NMC
        bool "NMC/Graphite Li-ion, 3.7V nominal, 4.2V max"

    config BAT_DEFAULT_TYPE_NMC_HV
        bool "NMC/Graphite High Voltage Li-ion, 3.7V nominal, 4.35 max"
endchoice

# values must match enum BatType in bat_charger.h
config BAT_DEFAULT_TYPE
    int
    default 1 if BAT_DEFAULT_TYPE_FLOODED
    default 2 if BAT_DEFAULT_TYPE_GEL
    default 3 if BAT_DEFAULT_TYPE_AGM
    default 4 if BAT_DEFAULT_TYPE_LFP
    default 5 if BAT_DEFAULT_TYPE_NMC
    default 6 if BAT_DEFAULT_TYPE_NMC_HV

config BAT_DEFAULT_NUM_CELLS
	int "Default number of battery cells"
	default 6
	range 3 16
	help
      Typical choices:
      - 6 for 12V lead-acid battery
      - 4 for 12V LiFePO4 battery
      - 3 for 12V NMC Li-ion battery

      Remarks:
      - If you choose settings for 12V system, 24V systems
	    (2 batteries in series) are recognized automatically
      - Make sure the voltage of the used charge controller
        is not exceeded.

config BAT_DEFAULT_CAPACITY_AH
    int "Default battery capacity in Ah"
    range 10 200
    default 50

endmenu


menu "Extensions and interfaces"

config EXT_OLED_DISPLAY
    bool "OLED display at UEXT"

config EXT_OLED_BRIGHTNESS
    depends on EXT_OLED_DISPLAY
    int "OLED display brightness"
    range 1 255
    default 1

config EXT_THINGSET_SERIAL
    bool "ThingSet serial interface"

config EXT_THINGSET_SERIAL_RX_BUF_SIZE
    depends on EXT_THINGSET_SERIAL
    int "ThingSet serial RX buffer size"
    range 64 2048
    default 512

config EXT_THINGSET_SERIAL_TX_BUF_SIZE
    depends on EXT_THINGSET_SERIAL
    int "ThingSet serial TX buffer size"
    range 256 2048
    default 1024

config EXT_THINGSET_CAN
    depends on CAN
    bool "ThingSet CAN interface"

config THINGSET_CAN_DEFAULT_NODE_ID
    depends on EXT_THINGSET_CAN
    int "ThingSet CAN default node ID"
    range 0 255
    default 20

config THINGSET_EXPERT_PASSWORD
    depends on EXT_THINGSET_SERIAL || EXT_THINGSET_CAN
    string "ThingSet expert user password"
    default "expert123"

config THINGSET_MAKER_PASSWORD
    depends on EXT_THINGSET_SERIAL || EXT_THINGSET_CAN
    string "ThingSet maker password"
    default "maker456"

endmenu


menuconfig CUSTOMIZATION
    bool "Firmware customization"
    help
      Activating this option allows to overwrite existing firmware functions
      or add customizations independent of the master branch.
      Custom implementations should be stored in the
      src/custom subdirectory.

if CUSTOMIZATION

config CUSTOM_DATA_NODES_FILE
    bool "Use custom data nodes file"
    default n
    help
      Use a custom file instead of default data_nodes.cpp for
      ThingSet configuration.

config CUSTOM_DCDC_CONTROLLER
    bool "Custom implementation of DC/DC controller"
    depends on $(dt_compat_enabled,dcdc)
    default n
    help
      Use a custom implementation instead of the default perturb & observe
      MPPT control.

endif
```

## boards/Kconfig.hidden
```kconfig
# SPDX-License-Identifier: Apache-2.0
# Copyright (c) 2019 Martin Jäger (Libre Solar)
#
# Invisible (hardware-specific) Kconfig symbols
#

config DEVICE_TYPE
	string
	help
	  Device type name, e.g. MPPT-2420-LC

config HARDWARE_VERSION
	string
	help
	  Version of the PCB

config HAS_DCDC_CONVERTER
	bool
	help
	  Board has a DC/DC converter.

config DCDC_PWM_FREQUENCY_KHZ
	depends on HAS_DCDC_CONVERTER
	int
	range 30 100
	help
	  PWM frequency of DC/DC converter in kHz, range 30 to 100.

config DCDC_PWM_DEADTIME_NS
	depends on HAS_DCDC_CONVERTER
	int
	range 100 300
	help
	  Dead time for synchronous PWM generation in nanoseconds.

config HAS_PWM_SWITCH
	bool
	help
	  PCB has PWM power switch.

config HAS_LOAD_OUTPUT
	bool
	help
	  PCB has a load output.

config HAS_USB_PWR_OUTPUT
	bool
	help
	  PCB has a USB power output.

config NUM_LED_PINS
	int
	help
	  Number of LED pins for charlieplexing.

config LOW_SIDE_VOLTAGE_MAX
	int
	help
	  Low side (usually battery) voltage maximum.

config HIGH_SIDE_VOLTAGE_MAX
	int
	help
	  High side (usually solar panel) voltage maximum.

config CONTROL_FREQUENCY
	int
	default 10
	help
	  Main control function frequency (Hz)

	  Frequencies higher than 10 Hz caused issues with MPPT control during lab test with
	  PV simulator. Might be different with actual solar panel.

config MOSFET_MAX_JUNCTION_TEMP
	int
	default 120
	help
	  Maximum Tj of MOSFETs (°C)

	  This value is used for model-based control of overcurrent protection. It represents
	  the steady-state junction temperature for max. continuous current at ambient
	  temperature of 25°C.

config INTERNAL_MAX_REFERENCE_TEMP
	int
	default 50
	help
	  Internal reference temperature at full load (°C)

	  This value is used for model-based control of overcurrent protection. It represents
	  the steady-state internal temperature for max. continuous current at ambient
	  temperature of 25°C. Value here is conservative and can be overwritten in PCB
	  configuration.

config MOSFET_THERMAL_TIME_CONSTANT
	int
	default 5
	help
	  Thermal time constant junction to ambient (s)

	  This value is used for model-based control of overcurrent protection. It does not reflect
	  the much lower MOSFET-internal time constant junction to case, but includes thermal
	  inertia of the board.

	  Around 5s seems to be a good conservative estimation for 5x6 type SMD MOSFETs
```

## boards/arm/mppt1210hus_0v4/Kconfig
```kconfig
# SPDX-License-Identifier: Apache-2.0
# Copyright (c) 2019 Martin Jäger / Libre Solar

# include generic charge controller Kconfig
source "$(BOARD_DIR)/../../Kconfig"
```

## boards/arm/mppt1210hus_0v4/Kconfig.board
```kconfig
# SPDX-License-Identifier: Apache-2.0
# Copyright (c) 2019 Martin Jäger / Libre Solar

config BOARD_MPPT1210HUS_0V4
	bool "Libre Solar MPPT 1210 HUS v0.4"
	depends on SOC_STM32L073XX
```

## boards/arm/mppt1210hus_0v4/Kconfig.defconfig
```kconfig
# SPDX-License-Identifier: Apache-2.0
# Copyright (c) 2019 Martin Jäger / Libre Solar

if BOARD_MPPT1210HUS_0V4

config BOARD
	default "mppt1210hus_0v4"

config HAS_DCDC_CONVERTER
	default y

config HAS_LOAD_OUTPUT
	default y

config NUM_LED_PINS
	default 5

if UART_CONSOLE

config UART_2
	default y

endif # UART_CONSOLE

if I2C

config I2C_1
	default y

endif # I2C

if SPI

config SPI_1
	default y

config SPI_STM32_INTERRUPT
	default y

endif # SPI

endif # BOARD_MPPT1210HUS_0V4
```

## boards/arm/mppt_1210_hus/Kconfig.board
```kconfig
# Copyright (c) The Libre Solar Project Contributors
# SPDX-License-Identifier: Apache-2.0

config BOARD_MPPT_1210_HUS
	bool "Libre Solar MPPT 1210 HUS"
	depends on SOC_STM32L072XX
```

## boards/arm/mppt_1210_hus/Kconfig.defconfig
```kconfig
# SPDX-License-Identifier: Apache-2.0
# Copyright (c) 2019 Martin Jäger / Libre Solar

if BOARD_MPPT_1210_HUS

config BOARD
	default "mppt_1210_hus"

config LIBRE_SOLAR_TYPE_ID
	default 4

if SPI

config SPI_STM32_INTERRUPT
	default y

endif # SPI

endif # BOARD_MPPT_1210_HUS_0V7
```

## boards/arm/mppt_1210_hus/mppt_1210_hus_defconfig
```kconfig
# SPDX-License-Identifier: Apache-2.0

CONFIG_SOC_SERIES_STM32L0X=y
CONFIG_SOC_STM32L072XX=y

#CONFIG_ARM_MPU=y

CONFIG_CLOCK_CONTROL=y

CONFIG_PINMUX=y

CONFIG_GPIO=y

CONFIG_SERIAL=y

CONFIG_CONSOLE=y
CONFIG_UART_CONSOLE=y

CONFIG_EEPROM=y
CONFIG_EEPROM_STM32=y
```

## boards/arm/mppt_1210_hus_0v4/Kconfig.defconfig
```kconfig
# SPDX-License-Identifier: Apache-2.0
# Copyright (c) 2019 Martin Jäger / Libre Solar

if BOARD_MPPT_1210_HUS_0V4

config BOARD
	default "mppt_1210_hus_0v4"

config HAS_LOAD_OUTPUT
	default y

config HAS_USB_PWR_OUTPUT
	default y

if UART_CONSOLE

config UART_2
	default y

endif # UART_CONSOLE

if I2C

config I2C_1
	default y

endif # I2C

if SPI

config SPI_1
	default y

config SPI_STM32_INTERRUPT
	default y

endif # SPI

endif # BOARD_MPPT_1210_HUS_0V4
```

## boards/arm/mppt_1210_hus_0v7/Kconfig.board
```kconfig
# SPDX-License-Identifier: Apache-2.0
# Copyright (c) 2019 Martin Jäger / Libre Solar

config BOARD_MPPT_1210_HUS_0V7
	bool "Libre Solar MPPT 1210 HUS v0.7"
	depends on SOC_STM32L073XX
```

## boards/arm/mppt_2420_hc/Kconfig.board
```kconfig
# Copyright (c) The Libre Solar Project Contributors
# SPDX-License-Identifier: Apache-2.0

config BOARD_MPPT_2420_HC
	bool "Libre Solar MPPT 2420 HC"
	depends on SOC_STM32G431XX
```

## boards/arm/mppt_2420_hc/Kconfig.defconfig
```kconfig
# Copyright (c) The Libre Solar Project Contributors
# SPDX-License-Identifier: Apache-2.0

if BOARD_MPPT_2420_HC

config BOARD
	default "mppt_2420_hc"

config LIBRE_SOLAR_TYPE_ID
	default 8

endif # BOARD_MPPT_2420_HC
```

## boards/arm/mppt_2420_hc/mppt_2420_hc_defconfig
```kconfig
# SPDX-License-Identifier: Apache-2.0

CONFIG_SOC_SERIES_STM32G4X=y
CONFIG_SOC_STM32G431XX=y

CONFIG_ARM_MPU=y
CONFIG_HW_STACK_PROTECTION=y
CONFIG_MPU_ALLOW_FLASH_WRITE=y

CONFIG_CLOCK_CONTROL=y

CONFIG_PINCTRL=y

CONFIG_GPIO=y

CONFIG_SERIAL=y

CONFIG_CONSOLE=y
CONFIG_UART_CONSOLE=y

CONFIG_PWM=y

CONFIG_CAN=y
CONFIG_THINGSET_CAN=y

CONFIG_ISOTP=y
```

## boards/arm/mppt_2420_hpx/Kconfig
```kconfig
# SPDX-License-Identifier: Apache-2.0
# Copyright (c) 2019 Martin Jäger / Libre Solar

# include generic charge controller Kconfig
rsource "../../Kconfig"
```

## boards/arm/mppt_2420_hpx/Kconfig.board
```kconfig
# Copyright (c) The Libre Solar Project Contributors
# SPDX-License-Identifier: Apache-2.0

config BOARD_MPPT_2420_HPX
	bool "Libre Solar MPPT 2420 HPX"
	depends on SOC_STM32G431XX
```

## boards/arm/mppt_2420_hpx/Kconfig.defconfig
```kconfig
# Copyright (c) The Libre Solar Project Contributors
# SPDX-License-Identifier: Apache-2.0

if BOARD_MPPT_2420_HPX

config BOARD
	default "mppt_2420_hpx"

config LIBRE_SOLAR_TYPE_ID
	default 7

if SPI

config SPI_STM32_INTERRUPT
	default y

endif # SPI

endif # BOARD_MPPT_2420_HPX
```

## boards/arm/mppt_2420_hpx/mppt_2420_hpx_defconfig
```kconfig
# SPDX-License-Identifier: Apache-2.0

CONFIG_SOC_SERIES_STM32G4X=y
CONFIG_SOC_STM32G431XX=y

CONFIG_ARM_MPU=y
CONFIG_HW_STACK_PROTECTION=y

CONFIG_CLOCK_CONTROL=y

CONFIG_PINCTRL=y

CONFIG_GPIO=y

CONFIG_SERIAL=y

CONFIG_CONSOLE=y
CONFIG_UART_CONSOLE=y

CONFIG_PWM=y

CONFIG_I2C=y
CONFIG_EEPROM=y
CONFIG_EEPROM_AT24=y
```

## boards/arm/mppt_2420_lc/Kconfig
```kconfig
# SPDX-License-Identifier: Apache-2.0
# Copyright (c) 2020 Martin Jäger / Libre Solar

# include generic charge controller Kconfig
rsource "../../Kconfig"
```

## boards/arm/mppt_2420_lc/Kconfig.board
```kconfig
# Copyright (c) The Libre Solar Project Contributors
# SPDX-License-Identifier: Apache-2.0

config BOARD_MPPT_2420_LC
	bool "Libre Solar MPPT 2420 LC"
	depends on SOC_STM32F072XB
```

## boards/arm/mppt_2420_lc/Kconfig.defconfig
```kconfig
# Copyright (c) The Libre Solar Project Contributors
# SPDX-License-Identifier: Apache-2.0

if BOARD_MPPT_2420_LC

config BOARD
	default "mppt_2420_lc"

config LIBRE_SOLAR_TYPE_ID
	default 1

if SPI

config SPI_STM32_INTERRUPT
	default y

endif # SPI

endif # BOARD_MPPT_2420_LC_0V10
```

## boards/arm/mppt_2420_lc/mppt_2420_lc_defconfig
```kconfig
# SPDX-License-Identifier: Apache-2.0

CONFIG_SOC_SERIES_STM32F0X=y
CONFIG_SOC_STM32F072XB=y

CONFIG_CLOCK_CONTROL=y

CONFIG_PINCTRL=y

CONFIG_GPIO=y

CONFIG_SERIAL=y

CONFIG_CONSOLE=y
CONFIG_UART_CONSOLE=y

CONFIG_I2C=y
CONFIG_EEPROM=y
CONFIG_EEPROM_AT24=y

# too little RAM, can only be enabled if serial is disabled
#CONFIG_CAN=y
#CONFIG_THINGSET_CAN=y
```

## boards/arm/mppt_2420_lc_0v10/Kconfig.board
```kconfig
# SPDX-License-Identifier: Apache-2.0
# Copyright (c) 2020 Martin Jäger / Libre Solar

config BOARD_MPPT_2420_LC_0V10
	bool "Libre Solar MPPT 2420 LC v0.10"
	depends on SOC_STM32F072XB
```

## boards/arm/mppt_2420_lc_0v10/Kconfig.defconfig
```kconfig
# SPDX-License-Identifier: Apache-2.0
# Copyright (c) 2019 Martin Jäger / Libre Solar

if BOARD_MPPT_2420_LC_0V10

config BOARD
	default "mppt_2420_lc_0v10"

config HAS_LOAD_OUTPUT
	default y

config NUM_LED_PINS
	default 2

if UART_CONSOLE

config UART_2
	default y

endif # UART_CONSOLE

if I2C

config I2C_1
	default y

endif # I2C

if SPI

config SPI_1
	default y

config SPI_STM32_INTERRUPT
	default y

endif # SPI

endif # BOARD_MPPT_2420_LC_0V10
```

## boards/arm/mppt_2420_rc/Kconfig.board
```kconfig
# SPDX-License-Identifier: Apache-2.0
# Copyright (c) 2020 Martin Jäger / Libre Solar

config BOARD_MPPT_2420_RC
	bool "Libre Solar MPPT 2420 RC"
	depends on SOC_STM32G431XX
```

## boards/arm/mppt_2420_rc/Kconfig.defconfig
```kconfig
# SPDX-License-Identifier: Apache-2.0
# Copyright (c) 2019 Martin Jäger / Libre Solar

if BOARD_MPPT_2420_RC

config BOARD
	default "mppt_2420_rc"

config LIBRE_SOLAR_TYPE_ID
	default 0


if SPI

config SPI_STM32_INTERRUPT
	default y

endif # SPI

endif # BOARD_MPPT_2420_RC
```

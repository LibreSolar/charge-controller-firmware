## zephyr/dts/bindings/adc-gain.yaml
```yaml
# SPDX-License-Identifier: Apache-2.0
# Copyright (c) 2020 Martin Jäger / Libre Solar

# Based on official Zephyr binding "voltage-divider" by Peter Bigot

description: |
    Description for a gain (voltage divider or amplifier) at an ADC input

compatible: "adc-gain"

properties:
    io-channels:
      type: phandle-array
      required: true
      description: |
        Channels available with this divider configuration.

    numerator:
      type: int
      required: true
      description: |
        Resistance of the lower leg of the voltage divider

    denominator:
      type: int
      required: true
      description: |
        Resistance of the full path through the voltage divider.

    raw-offset:
      type: int
      required: false
      description: |
        Offset to be substracted from ADC raw reading before applying the gain

    enable-gpios:
      type: phandle-array
      required: false
      description: |
        Enable the voltage divider input or amplifier.

        If present the corresponding GPIO must be set to an active level
        to enable the divider input.
```

## zephyr/dts/bindings/adc-inputs.yaml
```yaml
# SPDX-License-Identifier: Apache-2.0
# Copyright (c) 2020 Martin Jäger / Libre Solar

description: Description for an ADC input including gain (multiplier/divider) and offset

compatible: "adc-inputs"

child-binding:
  description: ADC inputs child node
  properties:
    io-channels:
      type: phandle-array
      required: true
      description: |
        ADC channel for this input.

    multiplier:
      type: int
      required: true
      description: |
        Resistance of the lower leg of the voltage divider.

    divider:
      type: int
      required: true
      description: |
        Resistance of the full path through the voltage divider.

    offset:
      type: int
      required: false
      description: |
        Offset to be substracted from ADC raw reading before applying the gain

    filter-const:
      type: int
      default: 5
      description: Low-pass filter multiplier 1/(2^filter-const)

    enable-gpios:
      type: phandle-array
      required: false
      description: |
        Enable the voltage divider input or amplifier.

        If present the corresponding GPIO must be set to an active level
        to enable the divider input.
```

## zephyr/dts/bindings/charge-controller.yaml
```yaml
# SPDX-License-Identifier: Apache-2.0
# Copyright (c) 2020 Martin Jäger / Libre Solar

description: Generic charge controller device setup

compatible: "charge-controller"

properties:
  hs-voltage-max:
    type: int
    required: true
    description: Maximum voltage at high-side (typically PV input) in volts
  ls-voltage-max:
    type: int
    required: true
    description: Maximum voltage at low-side (typically battery) in volts
```

## zephyr/dts/bindings/charlieplexing-leds.yaml
```yaml
# SPDX-License-Identifier: Apache-2.0
# Copyright (c) 2020 Martin Jäger / Libre Solar

description: Description for an ADC input including gain (multiplier/divider) and offset

compatible: "charlieplexing-leds"

properties:
  gpios:
    type: phandle-array
    description: GPIO handle of pin

child-binding:
  description: GPIO child node
  properties:
    states:
      type: array
      description: |
        Pin states to switch on LED identified by child node. 1=on, 0=off, 2=floating
```

## zephyr/dts/bindings/dcdc.yaml
```yaml
# SPDX-License-Identifier: Apache-2.0
# Copyright (c) 2020 Martin Jäger / Libre Solar

description: DC/DC converter as part of MPPT charge controllers

compatible: "dcdc"

properties:
  timer:
    type: phandle
    required: true
    description: Timer used for PWM signal generation
  pwm-frequency:
    type: int
    required: true
    description: PWM frequency in Hz
  pwm-deadtime:
    type: int
    required: true
    description: Dead time for synchronous PWM generation in nanoseconds
  current-max:
    type: int
    required: true
    description: Maximum inductor current in amps
```

## zephyr/dts/bindings/outputs.yaml
```yaml
# Copyright (c) 2020 Martin Jäger / Libre Solar
# SPDX-License-Identifier: Apache-2.0

description: GPIOs used for digital output (either on/off type or PWM signal)

compatible: "outputs"

child-binding:
  description: GPIO digital outputs child node
  properties:
    gpios:
      type: phandle-array
      description: GPIO handle for on/off type output
    pwms:
      type: phandle-array
      description: PWM handle for PWM type output
    current-max:
      type: int
      description: Maximum current of driven power switch (A)
    label:
      type: string
      required: true
      description: Human readable string describing the device (used by Zephyr for API name)
    kconfig-flag:
      type: boolean
      description: This value can be checked by Kconfig parser using dt_node_has_bool_prop function
```

## zephyr/dts/bindings/pwm-out.yaml
```yaml
# Copyright (c) 2020 Martin Jäger / Libre Solar
# SPDX-License-Identifier: Apache-2.0

description: GPIO pins to generate a PWM signal

compatible: "pwm-out"

child-binding:
  description: PWM output child node
  properties:
    pwms:
      type: phandle-array
      required: true
    label:
      type: string
      required: true
      description: Human readable string describing the device (used by Zephyr for API name)
```

## zephyr/dts/bindings/pwm-switch.yaml
```yaml
# SPDX-License-Identifier: Apache-2.0
# Copyright (c) 2020 Martin Jäger / Libre Solar

description: MOSFETs of PWM charge controllers

compatible: "pwm-switch"

properties:
  pwm-frequency:
    type: int
    required: true
    description: PWM frequency in Hz
  current-max:
    type: int
    required: true
    description: Maximum inductor current in amps
```

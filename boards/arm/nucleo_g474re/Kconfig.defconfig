## boards/arm/nucleo_g474re/Kconfig.defconfig
```kconfig
# STM32G474RE Nucleo board configuration

# Copyright (c) 2019 STMicroelectronics.
# SPDX-License-Identifier: Apache-2.0

if BOARD_NUCLEO_G474RE

config BOARD
	default "nucleo_g474re"

config LIBRE_SOLAR_TYPE_ID
	default 0

endif # BOARD_NUCLEO_G431RB
```

## boards/arm/owntech_board/Kconfig.defconfig
```kconfig
# STM32 Nucleo-64 development board with STM32F334R8 MCU

# Copyright (c) 2016 RnDity Sp. z o.o.
# SPDX-License-Identifier: Apache-2.0

if BOARD_OWNTECH

config BOARD
	default "owntech_board"

config LIBRE_SOLAR_TYPE_ID
	default 0

endif # BOARD_NUCLEO_F334R8
```

## boards/arm/pwm_2420_lus/Kconfig.board
```kconfig
# Copyright (c) The Libre Solar Project Contributors
# SPDX-License-Identifier: Apache-2.0

config BOARD_PWM_2420_LUS
	bool "Libre Solar PWM 2420 LUS"
	depends on SOC_STM32L072XX
```

## boards/arm/pwm_2420_lus/Kconfig.defconfig
```kconfig
# Copyright (c) The Libre Solar Project Contributors
# SPDX-License-Identifier: Apache-2.0

if BOARD_PWM_2420_LUS

config BOARD
	default "pwm_2420_lus"

config LIBRE_SOLAR_TYPE_ID
	default 5

if SPI

config SPI_STM32_INTERRUPT
	default y

endif # SPI


endif # BOARD_PWM_2420_LUS
```

## boards/arm/pwm_2420_lus/pwm_2420_lus_defconfig
```kconfig
# SPDX-License-Identifier: Apache-2.0

CONFIG_SOC_SERIES_STM32L0X=y
CONFIG_SOC_STM32L072XX=y

CONFIG_CLOCK_CONTROL=y

CONFIG_PINCTRL=y

CONFIG_GPIO=y

CONFIG_SERIAL=y

CONFIG_CONSOLE=y
CONFIG_UART_CONSOLE=y

CONFIG_EEPROM=y
CONFIG_EEPROM_STM32=y
```

## boards/arm/pwm_2420_lus_0v3/Kconfig
```kconfig
# SPDX-License-Identifier: Apache-2.0
# Copyright (c) 2019 Martin Jäger / Libre Solar

# include generic charge controller Kconfig
rsource "../../Kconfig"

# include STM32 Cube HAL (temporary solution)

mainmenu "STM32_HAL_ADC"

config STM32_HAL_ADC
  default y
  bool
  select USE_STM32_HAL_ADC
  select USE_STM32_HAL_ADC_EX
```

## boards/arm/pwm_2420_lus_0v3/Kconfig.board
```kconfig
# SPDX-License-Identifier: Apache-2.0
# Copyright (c) 2019 Martin Jäger / Libre Solar

config BOARD_PWM_2420_LUS_0V3
	bool "Libre Solar PWM 2420 LUS v0.3"
	depends on SOC_STM32L073XX
```

## boards/arm/pwm_2420_lus_0v3/Kconfig.defconfig
```kconfig
# SPDX-License-Identifier: Apache-2.0
# Copyright (c) 2019 Martin Jäger / Libre Solar

if BOARD_PWM_2420_LUS_0V3

config BOARD
	default "pwm_2420_lus_0v3"

config HAS_LOAD_OUTPUT
	default y

config HAS_USB_PWR_OUTPUT
	default y

if UART_CONSOLE

config UART_2
	default y

endif # UART_CONSOLE

if I2C

config I2C_1
	default y

endif # I2C

if SPI

config SPI_1
	default y

config SPI_STM32_INTERRUPT
	default y

endif # SPI

endif # BOARD_PWM_2420_LUS_0V3
```

## boards/libresolar/mppt_2420_hc/mppt_2420_hc_0_2_4_defconfig
```kconfig
# SPDX-License-Identifier: Apache-2.0

CONFIG_FLASH=y
CONFIG_FLASH_PAGE_LAYOUT=y
CONFIG_FLASH_LOG_LEVEL_WRN=y

CONFIG_SPI=y
CONFIG_SPI_NOR=y
CONFIG_SPI_NOR_SFDP_RUNTIME=y
CONFIG_SPI_NOR_FLASH_LAYOUT_PAGE_SIZE=4096

CONFIG_NVS=y
CONFIG_NVS_LOG_LEVEL_WRN=y
```

## dts/bindings/half-bridge.yaml
```yaml
# Copyright (c) The Libre Solar Project Contributors
# SPDX-License-Identifier: Apache-2.0

description: Half bridge, consisting of two coupled PWM outputs

compatible: "half-bridge"

include: [base.yaml, pinctrl-device.yaml]

properties:
  frequency:
    type: int
    required: true
    description: PWM frequency in Hz

  deadtime:
    type: int
    required: true
    description: Dead time for synchronous PWM generation in nanoseconds
```

## dts/bindings/outputs.yaml
```yaml
# Copyright (c) The Libre Solar Project Contributors
# SPDX-License-Identifier: Apache-2.0

description: GPIOs used for digital output (either on/off type or PWM signal)

compatible: "outputs"

child-binding:
  description: GPIO digital outputs child node
  properties:
    gpios:
      type: phandle-array
      description: GPIO handle for on/off type output
    pwms:
      type: phandle-array
      description: PWM handle for PWM type output
    latching-pgood:
      type: boolean
      description: Driver for latching power good pin (optional)
    current-max:
      type: int
      description: Maximum current of driven power switch (A)
    kconfig-flag:
      type: boolean
      description: This value can be checked by Kconfig parser using dt_node_has_bool_prop function
```

## dts/bindings/zephyr,dummy-adc.yaml
```yaml
# Copyright (c) The Libre Solar Project Contributors
# SPDX-License-Identifier: Apache-2.0

description: ADC similar to STM32 for unit tests

compatible: "zephyr,dummy-adc"

include: adc-controller.yaml

properties:
    "#io-channel-cells":
      const: 1

io-channel-cells:
    - input
```

## dts/bindings/zephyr,dummy-pwm.yaml
```yaml
# Copyright (c) The Libre Solar Project Contributors
# SPDX-License-Identifier: Apache-2.0

description: PWM similar to STM32 for unit tests

compatible: "zephyr,dummy-pwm"

include: [pwm-controller.yaml, base.yaml]

properties:
    label:
      required: true

    "#pwm-cells":
      const: 3

pwm-cells:
  - channel
# period in terms of nanoseconds
  - period
  - flags
```

## zephyr/Kconfig
```kconfig
# SPDX-License-Identifier: Apache-2.0
# Copyright (c) 2019 Martin Jäger (Libre Solar)

mainmenu "Libre Solar Charge Controller Firmware"

#
# Invisible (board-specific) Kconfig symbols
#

config CONTROL_FREQUENCY
    int
    default 10
    help
      Main control function frequency (Hz)

      Frequencies higher than 10 Hz caused issues with MPPT control during lab test with
      PV simulator. Might be different with actual solar panel.

config LIBRE_SOLAR_TYPE_ID
    int
    help
      Numeric Libre Solar hardware type ID

config HS_MOSFET_FAIL_SAFE_PROTECTION
    bool
    default y
    help
      If enabled, the DC/DC control function will will detect if the high-side MOSFET has failed
      short and trip the fuse by switching the low-side MOSFET continuously on. This will prevent
      accidental overcharging of the battery.

#
# Visible (user-configurable) Kconfig symbols
#

menu "Charge Controller Setup"

choice
    prompt "High-voltage terminal"
    depends on $(dt_compat_enabled,dcdc)
    help
      Select the device connected to the high-voltage
      side terminal of the DC/DC converter.

    config HV_TERMINAL_SOLAR
        bool "Solar panel"

    config HV_TERMINAL_NANOGRID
        bool "DC nanogrid"

    config HV_TERMINAL_GENERATOR
        bool "DC generator, e.g. wind turbine"

    config HV_TERMINAL_BATTERY
        bool "Battery, e.g. electric bicycle"
endchoice


choice
    prompt "Low-voltage terminal"
    help
      Select the device connected to the low-voltage side
      of the charge controller (usually battery terminal).

    config LV_TERMINAL_BATTERY
        depends on !HV_TERMINAL_BATTERY
        bool "Battery 12V/24V"

    config LV_TERMINAL_SOLAR
        depends on HV_TERMINAL_BATTERY || HV_TERMINAL_NANOGRID
        bool "Solar panel"
endchoice


choice
    prompt "PWM terminal"
    depends on $(dt_node_has_bool_prop,/outputs/pwm_switch,kconfig-flag)
    help
      Select the device connected to the PWM switch (currently
      only solar panel possible)

    config PWM_TERMINAL_SOLAR
        depends on LV_TERMINAL_BATTERY && !HV_TERMINAL_SOLAR
        bool "Solar panel"
endchoice


menu "Battery default settings"

choice
    prompt "Battery type"
    default BAT_TYPE_GEL
    help
      Select the type of the single cells inside the battery
      to determine voltage set points. Total voltage set points
      are multiplied with the selected number of cells.

    config BAT_TYPE_CUSTOM
        bool "Custom type"

    config BAT_TYPE_FLOODED
        bool "Flooded (wet) lead-acid"

    config BAT_TYPE_GEL
        bool "VRLA gel, maintainance-free"

    config BAT_TYPE_AGM
        bool "AGM, maintainance-free"

    config BAT_TYPE_LFP
        bool "LiFePO4 Li-ion, 3.3V nominal"

    config BAT_TYPE_NMC
        bool "NMC/Graphite Li-ion, 3.7V nominal, 4.2V max"

    config BAT_TYPE_NMC_HV
        bool "NMC/Graphite High Voltage Li-ion, 3.7V nominal, 4.35 max"
endchoice

# values must match enum BatType in bat_charger.h
config BAT_TYPE
    int
    default 0 if BAT_TYPE_CUSTOM
    default 1 if BAT_TYPE_FLOODED
    default 2 if BAT_TYPE_GEL
    default 3 if BAT_TYPE_AGM
    default 4 if BAT_TYPE_LFP
    default 5 if BAT_TYPE_NMC
    default 6 if BAT_TYPE_NMC_HV

config BAT_CAPACITY_AH
    int "Battery nominal capacity in Ah"
    range 10 200
    default 50
    help
      Nominal battery capacity or sum of parallel cells capacity

config BAT_NUM_CELLS
    int "Number of cells for single battery" if BAT_TYPE_CUSTOM
    default 6 if BAT_TYPE_FLOODED || BAT_TYPE_GEL || BAT_TYPE_AGM
    default 4 if BAT_TYPE_LFP
    default 3 if BAT_TYPE_NMC || BAT_TYPE_NMC_HV
    range 3 16
    help
      Typical choices:
      - 6 for 12V lead-acid battery
      - 4 for 12V LiFePO4 battery
      - 3 for 12V NMC Li-ion battery

      Remarks:
      - If you choose settings for 12V system, 24V systems
        (2 batteries in series) are recognized automatically
      - Make sure the voltage of the used charge controller
        is not exceeded.

menu "Custom cell-level settings"

config CELL_ABS_MAX_VOLTAGE_MV
    int "Absolute maximum voltage (mV)" if BAT_TYPE_CUSTOM
    default 2450
    help
      Above this voltage the battery or loads might get damaged.

config CELL_TOPPING_VOLTAGE_MV
    int "Topping voltage (mV)" if BAT_TYPE_CUSTOM
    default 2400
    help
      Charger target voltage, switching from CC to CV at this voltage threshold.

config CELL_RECHARGE_VOLTAGE_MV
    int "Recharge voltage (mV)" if BAT_TYPE_CUSTOM
    default 2300
    help
      Start charging again if voltage of fully charged battery drops below this threshold.

config CELL_RECONNECT_VOLTAGE_MV
    int "Load reconnect cell voltage (mV)" if BAT_TYPE_CUSTOM
    default 2100
    help
      Re-enable the load only after charged beyond this value.

config CELL_DISCONNECT_VOLTAGE_MV
    int "Load disconnect cell voltage (mV)" if BAT_TYPE_CUSTOM
    default 1950
    help
      Load output is disabled if battery voltage is below this threshold.

config CELL_ABS_MIN_VOLTAGE_MV
    int "Topping voltage (mV)" if BAT_TYPE_CUSTOM
    default 1600
    help
      Below this voltage the battery is considered damaged.

config CELL_OCV_FULL_MV
    int "OCV full cell (mV)" if BAT_TYPE_CUSTOM
    default 2150
    help
      Voltages during idle (no charging/discharging current)

config CELL_OCV_EMPTY_MV
    int "OCV empty cell (mV)" if BAT_TYPE_CUSTOM
    default 1900
    help
      Voltages during idle (no charging/discharging current)

config CELL_TRICKLE
    bool "Enable trickle charging phase" if BAT_TYPE_CUSTOM
    default y

config CELL_TRICKLE_VOLTAGE_MV
    int "Trickle charging cell voltage (mV)" if BAT_TYPE_CUSTOM && CELL_TRICKLE
    default 2300
    help
      Charger target voltage for trickle charging of lead-acid batteries

config CELL_TRICKLE_RECHARGE_TIME
    int "Trickle recharge time (s)" if BAT_TYPE_CUSTOM && CELL_TRICKLE
    default 1800
    help
      If the trickle voltage is not reached anymore (e.g. because of lack of solar
      input power) for this period of time, the charger state machine goes back
      into CC/bulk charging mode.

config CELL_EQUALIZATION
    bool "Enable equalization phase" if BAT_TYPE_CUSTOM
    default n
    help
      Enable for flooded batteries only.

config CELL_EQUALIZATION_VOLTAGE_MV
    int "Equalization phase cell voltage (mV)" if BAT_TYPE_CUSTOM && CELL_EQUALIZATION
    default 2450
    help
      Charger target voltage for equalization charging of lead-acid batteries

config CELL_EQUALIZATION_DURATION
    int "Equalization duration (seconds)" if BAT_TYPE_CUSTOM && CELL_EQUALIZATION
    default 3600
    help
      After this time, equalization charging is stopped.

config CELL_EQUALIZATION_TRIGGER_DAYS
    int "Equalization time trigger (days)" if BAT_TYPE_CUSTOM && CELL_EQUALIZATION
    default 60
    help
      After passing specified amount of days, an equalization charge is triggered.

config CELL_EQUALIZATION_TRIGGER_DEEP_CYCLES
    int "Equalization deep cycle count trigger" if BAT_TYPE_CUSTOM && CELL_EQUALIZATION
    default 10
    help
      After specified number of deep discharges, an equalization charge is triggered.

config CELL_TEMP_COMPENSATION_MV_K
    int "Cell voltage temperature compenstaion (mV/K)" if BAT_TYPE_CUSTOM
    range -5 0
    default -3
    help
      Suggested value: -3 mV/K/cell for lead-acid batteries, 0 for Li-ion batteries

config CELL_INTERNAL_RESISTANCE_MOHM
    int "Cell internal resistance (mOhm)" if BAT_TYPE_CUSTOM
    range 1 30
    default 5

endmenu # Custom cell-level settings

menu "Custom temperature settings"

config BAT_CHARGE_TEMP_MAX
    int "Maximum charge temperature (°C)" if BAT_TYPE_CUSTOM
    range 0 60
    default 50

config BAT_CHARGE_TEMP_MIN
    int "Minimum charge temperature (°C)" if BAT_TYPE_CUSTOM
    range -10 20
    default 0

config BAT_DISCHARGE_TEMP_MAX
    int "Maximum discharge temperature (°C)" if BAT_TYPE_CUSTOM
    range 0 60
    default 50

config BAT_DISCHARGE_TEMP_MIN
    int "Minimum discharge temperature (°C)" if BAT_TYPE_CUSTOM
    range -20 20
    default -10

endmenu # Custom temperature settings

endmenu # Battery default settings


menu "Load output settings"
    depends on $(dt_node_has_bool_prop,/outputs/load,kconfig-flag)

config LOAD_OC_RECOVERY_DELAY
    int "Overcurrent recovery delay (s)"
    default 300

config LOAD_LVD_RECOVERY_DELAY
    int "Low-voltage disconnect recovery delay (s)"
    default 300
    help
      Prevents toggling load output in case of heavy load and low state of charge.

endmenu # Load output settings


endmenu # Charge controller setup


menu "UEXT port"

config EXT_OLED_DISPLAY
    bool "OLED display"

config EXT_OLED_BRIGHTNESS
    depends on EXT_OLED_DISPLAY
    int "OLED display brightness"
    range 1 255
    default 1

config UEXT_SERIAL_THINGSET
    depends on THINGSET_SERIAL
    bool "Use UEXT serial for ThingSet interface"
    default n
    help
      If the ThingSet interface is not attached to the serial port in the UEXT connector, the
      debug serial connector is used (if existing).

endmenu # UEXT port


menu "ThingSet interfaces"

config THINGSET_SERIAL
    bool "ThingSet serial interface"

config THINGSET_SERIAL_RX_BUF_SIZE
    depends on THINGSET_SERIAL
    int "ThingSet serial RX buffer size"
    range 64 2048
    default 512

config THINGSET_SERIAL_TX_BUF_SIZE
    depends on THINGSET_SERIAL
    int "ThingSet serial TX buffer size"
    range 256 2048
    default 1024

config THINGSET_CAN
    depends on CAN
    bool "ThingSet CAN interface"

config THINGSET_CAN_DEFAULT_NODE_ID
    depends on THINGSET_CAN
    int "ThingSet CAN default node ID"
    range 0 255
    default 20

config THINGSET_EXPERT_PASSWORD
    string "ThingSet expert user password"
    default "expert123"

config THINGSET_MAKER_PASSWORD
    string "ThingSet maker password"
    default "maker456"

endmenu # ThingSet interfaces


menuconfig CUSTOMIZATION
    bool "Firmware customization"
    help
      Activating this option allows to overwrite existing firmware functions
      or add customizations independent of the master branch.
      Custom implementations should be stored in the
      src/custom subdirectory.

if CUSTOMIZATION

config CUSTOM_DATA_NODES_FILE
    bool "Use custom data nodes file"
    default n
    help
      Use a custom file instead of default data_nodes.cpp for
      ThingSet configuration.

config CUSTOM_DCDC_CONTROLLER
    bool "Custom implementation of DC/DC controller"
    depends on $(dt_compat_enabled,dcdc)
    default n
    help
      Use a custom implementation instead of the default perturb & observe
      MPPT control.

endif

# include custom Kconfig if existing
orsource "../src/custom/Kconfig"

# include main Zephyr menu entries from Zephyr root directory
source "Kconfig.zephyr"
```

## zephyr/dts/bindings/switch.yaml
```yaml
# Copyright (c) 2020 Martin Jäger / Libre Solar
# SPDX-License-Identifier: Apache-2.0

title: GPIO switch parent node
description: GPIO pins to switch something on or off

compatible: "switch"

child-binding:
  title: GPIO switch child node
  description: GPIO switch child node
  properties:
    gpios:
      type: phandle-array
      required: true
    label:
      type: string
      required: true
      description: Human readable string describing the device (used by Zephyr for API name)
```

## zephyr/west.yml
```yaml
manifest:
  remotes:
    - name: zephyrproject
      url-base: https://github.com/zephyrproject-rtos
    - name: libresolar
      url-base: https://github.com/LibreSolar
    - name: thingset
      url-base: https://github.com/ThingSet
  projects:
    - name: zephyr
      remote: zephyrproject
      revision: v2.7-branch
      # path must be something else than zephyr as we get a Kconfig include recursion otherwise
      path: rtos
      import:
        # main zephyr modules should be placed in here into zephyr subdirectory
        path-prefix: zephyr
        # only get modules we actually need
        name-allowlist:
          - cmsis
          - edtt
          - hal_stm32
    - name: thingset-device-library
      remote: thingset
      revision: 1eaa305a9f1873f676b77b8dd0f9d34f1944ecd1
      path: zephyr/modules/thingset
```

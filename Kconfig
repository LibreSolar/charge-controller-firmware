## Kconfig
```kconfig
# Copyright (c) The Libre Solar Project Contributors
# SPDX-License-Identifier: Apache-2.0

rsource "drivers/Kconfig"
```

## boards/libresolar/mppt_1210_hus/Kconfig.defconfig
```kconfig
# Copyright (c) The Libre Solar Project Contributors
# SPDX-License-Identifier: Apache-2.0

if BOARD_MPPT_1210_HUS

if SPI

config SPI_STM32_INTERRUPT
	default y

endif # SPI

endif # BOARD_MPPT_1210_HUS_0V7
```

## boards/libresolar/mppt_2420_hc/board.yml
```yaml
board:
  name: mppt_2420_hc
  full_name: Libre Solar MPPT 2420 HC
  vendor: libresolar
  socs:
    - name: stm32g431xx
  revision:
    format: major.minor.patch
    default: "0.2.0"
    revisions:
      - name: "0.1.0"
      - name: "0.2.0"
      - name: "0.2.4"
```

## boards/libresolar/mppt_2420_rc/Kconfig.defconfig
```kconfig
# Copyright (c) The Libre Solar Project Contributors
# SPDX-License-Identifier: Apache-2.0

if BOARD_MPPT_2420_RC

if SPI

config SPI_STM32_INTERRUPT
	default y

endif # SPI

endif # BOARD_MPPT_2420_RC
```

## boards/libresolar/mppt_2420_solaris/Kconfig.defconfig
```kconfig
# Copyright (c) The Libre Solar Project Contributors
# SPDX-License-Identifier: Apache-2.0

if BOARD_MPPT_2420_SOLARIS

config LIBRE_SOLAR_TYPE_ID
	default 8

endif # BOARD_MPPT_2420_SOLARIS
```

## boards/libresolar/mppt_2420_solaris/Kconfig.mppt_2420_solaris
```kconfig
# Copyright (c) The Libre Solar Project Contributors
# SPDX-License-Identifier: Apache-2.0

config BOARD_MPPT_2420_SOLARIS
	select SOC_STM32G491XX
```

## boards/libresolar/mppt_2420_solaris/board.yml
```yaml
board:
  name: mppt_2420_solaris
  full_name: Libre Solar MPPT 2420 SOLARIS
  vendor: libresolar
  socs:
    - name: stm32g491xx
```

## boards/libresolar/pwm_2420_lus/Kconfig.defconfig
```kconfig
# Copyright (c) The Libre Solar Project Contributors
# SPDX-License-Identifier: Apache-2.0

if BOARD_PWM_2420_LUS

if SPI

config SPI_STM32_INTERRUPT
	default y

endif # SPI

endif # BOARD_PWM_2420_LUS
```

## boards/shields/uext_oled/Kconfig.defconfig
```kconfig
# Copyright (c) The Libre Solar Project Contributors
# SPDX-License-Identifier: Apache-2.0

if SHIELD_UEXT_OLED

config SSD1306_DEFAULT_CONTRAST
	default 1

endif # SHIELD_UEXT_OLED
```

## boards/spinvert/boost_4820/Kconfig.spinvert_boost_4820
```kconfig
# Copyright (c) The Libre Solar Project Contributors
# SPDX-License-Identifier: Apache-2.0

config BOARD_SPINVERT_BOOST_4820
	select SOC_STM32G0B1XX
```

## boards/spinvert/boost_4820/board.yml
```yaml
board:
  name: spinvert_boost_4820
  full_name: Spinvert Boost 4820
  vendor: spinvert
  socs:
    - name: stm32g0b1xx
```

## drivers/Kconfig
```kconfig
# Copyright (c) The Libre Solar Project Contributors
# SPDX-License-Identifier: Apache-2.0

menu "Libre Solar drivers"

rsource "daq/Kconfig"
rsource "half_bridge/Kconfig"
rsource "power_switch/Kconfig"
rsource "stm32_tim/Kconfig"

endmenu
```

## drivers/daq/Kconfig
```kconfig
# Copyright (c) The Libre Solar Project Contributors
# SPDX-License-Identifier: Apache-2.0

menuconfig DAQ
    bool "Data acquisition (DAQ) drivers"
    default y if DT_HAS_LIBRESOLAR_STM32_DAQ_ENABLED
    default y if DT_HAS_LIBRESOLAR_DAQ_EMUL_ENABLED
    help
      Enable drivers for data acquisition, i.e. continuous sampling, filtering and limit
      checking of analog inputs.

if DAQ

config DAQ_INIT_PRIORITY
    int "DAQ init priority"
    default KERNEL_INIT_PRIORITY_DEVICE
    help
      DAQ driver device initialization priority.

module = DAQ
module-str = daq
source "subsys/logging/Kconfig.template.log_config"

config DAQ_STM32_CHSEL
    bool "STM32 DAQ driver for ADCs with fixed channel sequence"
    default y
    depends on DT_HAS_LIBRESOLAR_STM32_DAQ_ENABLED
    depends on SOC_SERIES_STM32F0X || SOC_SERIES_STM32L0X || SOC_SERIES_STM32G0X
    select USE_STM32_LL_ADC
    select USE_STM32_LL_DAC
    select USE_STM32_LL_DMA
    help
      Enable DAQ driver for STM32 ADCs converting the selected channels in ascending order
      (STM32F0, STM32L0 and STM32G0).

config DAQ_STM32_RANK
    bool "STM32 DAQ driver for ADCs with configurable channel sequence"
    default y
    depends on DT_HAS_LIBRESOLAR_STM32_DAQ_ENABLED
    depends on SOC_SERIES_STM32G4X
    select USE_STM32_LL_ADC
    select USE_STM32_LL_DAC
    select USE_STM32_LL_DMA
    help
      Enable DAQ driver for STM32 ADCs with ranks to define the channel sequence (STM32G4).

config DAQ_EMUL
    bool "Emulated DAQ driver"
    default y
    depends on DT_HAS_LIBRESOLAR_DAQ_EMUL_ENABLED
    help
      Enable emulated DAQ driver for tests on native_sim.

endif # DAQ
```

## drivers/half_bridge/Kconfig
```kconfig
# Copyright (c) The Libre Solar Project Contributors
# SPDX-License-Identifier: Apache-2.0

menuconfig HALF_BRIDGE
    bool "Half-bridge drivers"
    default y if DT_HAS_LIBRESOLAR_STM32_ADVTIM_HALF_BRIDGE_ENABLED
    default y if DT_HAS_LIBRESOLAR_STM32_GPTIM_HALF_BRIDGE_ENABLED
    default y if DT_HAS_LIBRESOLAR_STM32_HRTIM_HALF_BRIDGE_ENABLED
    default y if DT_HAS_LIBRESOLAR_HALF_BRIDGE_EMUL_ENABLED
    help
      Enable drivers for half bridges consisting of two complementary PWM outputs with dead time,
      e.g. used in DC/DC converters.

if HALF_BRIDGE

config HALF_BRIDGE_INIT_PRIORITY
    int "Half-bridge init priority"
    default KERNEL_INIT_PRIORITY_DEVICE
    help
      Half-bridge driver device initialization priority.

module = HALF_BRIDGE
module-str = half_bridge
source "subsys/logging/Kconfig.template.log_config"

config HALF_BRIDGE_STM32_TIM
    bool
    select USE_STM32_LL_TIM
    select PINCTRL
    select RESET
    help
      Common functions for half-bridge drivers using STM32 timers (TIM).

config HALF_BRIDGE_STM32_ADVTIM
    bool "STM32 advanced-control timer half-bridge driver"
    default y
    depends on DT_HAS_LIBRESOLAR_STM32_ADVTIM_HALF_BRIDGE_ENABLED
    select HALF_BRIDGE_STM32_TIM
    help
      Enable half-bridge driver for STM32 advanced-control timers (e.g. TIM1) using
      complementary outputs with hardware dead time generation.

config HALF_BRIDGE_STM32_GPTIM
    bool "STM32 general-purpose timer half-bridge driver"
    default y
    depends on DT_HAS_LIBRESOLAR_STM32_GPTIM_HALF_BRIDGE_ENABLED
    select HALF_BRIDGE_STM32_TIM
    help
      Enable half-bridge driver for STM32 general-purpose timers (e.g. TIM3) using two
      independent channels with dead time generated by software.

config HALF_BRIDGE_STM32_HRTIM
    bool "STM32 HRTIM half-bridge driver"
    default y
    depends on DT_HAS_LIBRESOLAR_STM32_HRTIM_HALF_BRIDGE_ENABLED
    select PINCTRL
    select RESET
    help
      Enable half-bridge driver for the STM32 high-resolution timer (HRTIM).

config HALF_BRIDGE_EMUL
    bool "Emulated half-bridge driver"
    default y
    depends on DT_HAS_LIBRESOLAR_HALF_BRIDGE_EMUL_ENABLED
    help
      Enable emulated half-bridge driver for tests on native_sim.

endif # HALF_BRIDGE
```

## drivers/power_switch/Kconfig
```kconfig
# Copyright (c) The Libre Solar Project Contributors
# SPDX-License-Identifier: Apache-2.0

menuconfig POWER_SWITCH
    bool "Power switch drivers"
    default y if DT_HAS_LIBRESOLAR_GPIO_POWER_SWITCH_ENABLED
    default y if DT_HAS_LIBRESOLAR_STM32_LPTIM_POWER_SWITCH_ENABLED
    help
      Enable drivers for power switches, e.g. used for load or USB outputs.

if POWER_SWITCH

config POWER_SWITCH_INIT_PRIORITY
    int "Power switch init priority"
    default 70
    help
      Power switch driver device initialization priority. Must be lower than the priority
      of the GPIO and PWM drivers.

module = POWER_SWITCH
module-str = power_switch
source "subsys/logging/Kconfig.template.log_config"

config POWER_SWITCH_GPIO
    bool "GPIO power switch driver"
    default y
    depends on DT_HAS_LIBRESOLAR_GPIO_POWER_SWITCH_ENABLED
    select GPIO
    help
      Enable driver for power switches driven by a GPIO.

DT_COMPAT_LIBRESOLAR_GPIO_POWER_SWITCH := libresolar,gpio-power-switch

config POWER_SWITCH_GPIO_CHARGE_PUMP
    bool
    default y
    depends on POWER_SWITCH_GPIO
    depends on $(dt_compat_any_has_prop,$(DT_COMPAT_LIBRESOLAR_GPIO_POWER_SWITCH),charge-pump-pwms)
    select PWM
    help
      Support for charge pump PWM signals of GPIO power switches.

config POWER_SWITCH_STM32_LPTIM
    bool "STM32 LPTIM power switch driver with short-circuit protection"
    default y
    depends on DT_HAS_LIBRESOLAR_STM32_LPTIM_POWER_SWITCH_ENABLED
    depends on SOC_SERIES_STM32L0X
    select GPIO
    select PINCTRL
    help
      Enable power switch driver using LPTIM1 and COMP2 of STM32L0 for hardware short-circuit
      protection.

endif # POWER_SWITCH
```

## drivers/sensor/Kconfig
```kconfig
# Copyright (c) The Libre Solar Project Contributors
# SPDX-License-Identifier: Apache-2.0

if SENSOR

rsource "daq_ntc/Kconfig"

endif # SENSOR
```

## drivers/sensor/daq_ntc/Kconfig
```kconfig
# Copyright (c) The Libre Solar Project Contributors
# SPDX-License-Identifier: Apache-2.0

config DAQ_NTC_THERMISTOR
    bool "NTC thermistor measured via DAQ"
    default y
    depends on DT_HAS_LIBRESOLAR_DAQ_NTC_THERMISTOR_ENABLED
    depends on DAQ
    help
      Enable driver for NTC thermistors measured via a channel of the data acquisition (DAQ)
      driver.
```

## drivers/stm32_tim/Kconfig
```kconfig
# Copyright (c) The Libre Solar Project Contributors
# SPDX-License-Identifier: Apache-2.0

config LIBRESOLAR_STM32_TIM
    bool
    select USE_STM32_LL_TIM
    select PINCTRL
    select RESET
    help
      Common functions for drivers using STM32 timers (TIM).
```

## dts/bindings/daq/daq-common.yaml
```yaml
# Copyright (c) The Libre Solar Project Contributors
# SPDX-License-Identifier: Apache-2.0

description: |
  Common properties for data acquisition (DAQ) devices

  The DAQ samples all inputs given as child nodes with 1 kHz, filters the readings with a
  low-pass filter and checks them against configurable limits.

  The node is expected at the path /adc-inputs. The following child node names have a special
  meaning:

  - vref-mcu: Internal reference voltage of the MCU, used to calculate the supply voltage of the
    ADC if no fixed reference voltage is available.
  - temp-mcu: Internal temperature sensor of the MCU.

child-binding:
  description: ADC input
  properties:
    io-channels:
      type: phandle-array
      required: true
      description: |
        ADC channel for this input.

    multiplier:
      type: int
      required: true
      description: |
        Gain numerator, e.g. the resistance of the full path through a voltage divider.

    divider:
      type: int
      required: true
      description: |
        Gain denominator, e.g. the resistance of the lower leg of a voltage divider.

    offset:
      type: int
      required: false
      description: |
        Offset to be subtracted from the 16-bit raw ADC reading before applying the gain

    filter-const:
      type: int
      default: 5
      description: Low-pass filter multiplier 1/(2^filter-const)

    enable-gpios:
      type: phandle-array
      required: false
      description: |
        Enable the voltage divider input or amplifier.

        If present the corresponding GPIO is set to its active level during initialization.
```

## dts/bindings/daq/libresolar,daq-emul.yaml
```yaml
# Copyright (c) The Libre Solar Project Contributors
# SPDX-License-Identifier: Apache-2.0

description: |
  Emulated data acquisition (DAQ) for tests on native_sim

  Readings are set and processed using the API from <libresolar/drivers/daq_emul.h>.

compatible: "libresolar,daq-emul"

include: daq-common.yaml
```

## dts/bindings/daq/libresolar,stm32-daq.yaml
```yaml
# Copyright (c) The Libre Solar Project Contributors
# SPDX-License-Identifier: Apache-2.0

description: |
  Data acquisition (DAQ) using the ADC of STM32 MCUs with DMA

  Conversions are triggered by a timer with 1 kHz and the results are transferred to RAM by the
  DMA controller. The DAC is used to generate reference voltages for current measurement
  amplifiers.

compatible: "libresolar,stm32-daq"

include: daq-common.yaml
```

## dts/bindings/half-bridge/half-bridge-common.yaml
```yaml
# Copyright (c) The Libre Solar Project Contributors
# SPDX-License-Identifier: Apache-2.0

description: Common properties for half bridges consisting of two complementary PWM outputs

properties:
  frequency:
    type: int
    required: true
    description: Switching frequency in Hz

  deadtime-ns:
    type: int
    required: true
    description: |
      Dead time in nanoseconds between switching off one MOSFET and switching on the other one
```

## dts/bindings/half-bridge/libresolar,half-bridge-emul.yaml
```yaml
# Copyright (c) The Libre Solar Project Contributors
# SPDX-License-Identifier: Apache-2.0

description: |
  Emulated half bridge for tests on native_sim

  Behaves like an edge-aligned timer, i.e. the period is clock-frequency / frequency.

compatible: "libresolar,half-bridge-emul"

include: [base.yaml, half-bridge-common.yaml]

properties:
  clock-frequency:
    type: int
    default: 24000000
    description: Emulated timer clock frequency in Hz
```

## dts/bindings/half-bridge/libresolar,stm32-advtim-half-bridge.yaml
```yaml
# Copyright (c) The Libre Solar Project Contributors
# SPDX-License-Identifier: Apache-2.0

description: |
  Half bridge using an STM32 advanced-control timer (e.g. TIM1)

  The node must be a child of an st,stm32-timers node. The high-side switch is driven by output
  CHx and the low-side switch by the complementary output CHxN. The timer runs in edge-aligned
  mode and the dead time is generated in hardware.

  Example:

    &timers1 {
        status = "okay";

        halfbridge: half-bridge {
            compatible = "libresolar,stm32-advtim-half-bridge";
            pinctrl-0 = <&tim1_ch1_pa8 &tim1_ch1n_pc13>;
            pinctrl-names = "default";
            channel = <1>;
            frequency = <70000>;
            deadtime-ns = <300>;
        };
    };

compatible: "libresolar,stm32-advtim-half-bridge"

include: [base.yaml, pinctrl-device.yaml, half-bridge-common.yaml]

properties:
  pinctrl-0:
    required: true

  pinctrl-names:
    required: true

  channel:
    type: int
    required: true
    enum: [1, 2, 3, 4]
    description: |
      Timer channel driving the high-side switch with output CHx and the low-side switch with
      complementary output CHxN

  adc-trigger:
    type: boolean
    description: |
      Trigger ADC conversions in the middle of the on-time using OC6 via TRGO2

      Only supported by timers providing channel 6 and TRGO2 (e.g. TIM1 of STM32G4).
```

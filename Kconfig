## dts/bindings/half-bridge/libresolar,stm32-gptim-half-bridge.yaml
```yaml
# Copyright (c) The Libre Solar Project Contributors
# SPDX-License-Identifier: Apache-2.0

description: |
  Half bridge using an STM32 general-purpose timer (e.g. TIM3)

  The node must be a child of an st,stm32-timers node. As general-purpose timers have no
  hardware dead time generation, the high-side and low-side switches are driven by two
  independent channels. The timer runs in center-aligned mode and the dead time is generated by
  shifting the compare value of the low-side channel, which has inverted polarity.

  Example:

    &timers3 {
        status = "okay";

        halfbridge: half-bridge {
            compatible = "libresolar,stm32-gptim-half-bridge";
            pinctrl-0 = <&tim3_ch3_pb0 &tim3_ch4_pb1>;
            pinctrl-names = "default";
            high-side-channel = <3>;
            low-side-channel = <4>;
            frequency = <50000>;
            deadtime-ns = <230>;
        };
    };

compatible: "libresolar,stm32-gptim-half-bridge"

include: [base.yaml, pinctrl-device.yaml, half-bridge-common.yaml]

properties:
  pinctrl-0:
    required: true

  pinctrl-names:
    required: true

  high-side-channel:
    type: int
    required: true
    enum: [1, 2, 3, 4]
    description: Timer channel driving the high-side switch

  low-side-channel:
    type: int
    required: true
    enum: [1, 2, 3, 4]
    description: Timer channel driving the low-side switch
```

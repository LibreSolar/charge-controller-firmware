## dts/bindings/half-bridge/libresolar,stm32-half-bridge.yaml
```yaml
# Copyright (c) The Libre Solar Project Contributors
# SPDX-License-Identifier: Apache-2.0

description: |
  Half bridge using an STM32 timer (TIM)

  The node must be a child of an st,stm32-timers node. Two operating modes are supported:

  - Complementary outputs (default): The high-side switch is driven by output CHx and the
    low-side switch by the complementary output CHxN of an advanced-control timer like TIM1.
    The timer runs in edge-aligned mode and the dead time is generated in hardware.

  - Two independent channels (if low-side-channel is specified): The high-side and low-side
    switches are driven by two channels of a general-purpose timer like TIM3. The timer runs
    in center-aligned mode and the dead time is generated by shifting the compare value of the
    low-side channel, which has inverted polarity.

  Example for complementary outputs:

    &timers1 {
        status = "okay";

        halfbridge: half-bridge {
            compatible = "libresolar,stm32-half-bridge";
            pinctrl-0 = <&tim1_ch1_pa8 &tim1_ch1n_pc13>;
            pinctrl-names = "default";
            channel = <1>;
            frequency = <70000>;
            deadtime-ns = <300>;
        };
    };

compatible: "libresolar,stm32-half-bridge"

include: [base.yaml, pinctrl-device.yaml, half-bridge-common.yaml]

properties:
  pinctrl-0:
    required: true

  pinctrl-names:
    required: true

  channel:
    type: int
    required: true
    enum: [1, 2, 3, 4]
    description: Timer channel driving the high-side switch

  low-side-channel:
    type: int
    enum: [1, 2, 3, 4]
    description: |
      Timer channel driving the low-side switch

      If not specified, the complementary output of the high-side channel is used.

  adc-trigger:
    type: boolean
    description: |
      Trigger ADC conversions in the middle of the on-time using OC6 via TRGO2

      Only supported with complementary outputs and timers providing channel 6 and TRGO2
      (e.g. TIM1 of STM32G4).
```

## dts/bindings/half-bridge/libresolar,stm32-hrtim-half-bridge.yaml
```yaml
# Copyright (c) The Libre Solar Project Contributors
# SPDX-License-Identifier: Apache-2.0

description: |
  Half bridge using the STM32 high-resolution timer (HRTIM)

  The node must be a child of the HRTIM node, which provides the register address, the clocks
  and (optionally) the reset line. The first clock is used to enable the peripheral, the second
  clock must specify the timer clock source (e.g. STM32_SRC_TIMPCLK2).

  Only timer A with outputs TA1 (high-side) and TA2 (low-side) is supported at the moment.

  Example:

    &hrtim1 {
        status = "okay";

        halfbridge: half-bridge {
            compatible = "libresolar,stm32-hrtim-half-bridge";
            pinctrl-0 = <&hrtim1_cha1_pa8 &hrtim1_cha2_pa9>;
            pinctrl-names = "default";
            frequency = <70000>;
            deadtime-ns = <300>;
        };
    };

compatible: "libresolar,stm32-hrtim-half-bridge"

include: [base.yaml, pinctrl-device.yaml, half-bridge-common.yaml]

properties:
  pinctrl-0:
    required: true

  pinctrl-names:
    required: true

  adc-trigger:
    type: boolean
    description: |
      Trigger ADC1 conversions in the middle of the on-time using timer A compare 3
```

## dts/bindings/power-switch/libresolar,gpio-power-switch.yaml
```yaml
# Copyright (c) The Libre Solar Project Contributors
# SPDX-License-Identifier: Apache-2.0

description: |
  Power switch driven by a GPIO

  Example of a high-side load switch with charge pump:

    load_switch: load-switch {
        compatible = "libresolar,gpio-power-switch";
        gpios = <&gpiob 2 GPIO_ACTIVE_LOW>;
        charge-pump-pwms = <&pwm8 2 PWM_USEC(200) PWM_POLARITY_NORMAL>;
        current-max = <20>;
    };

compatible: "libresolar,gpio-power-switch"

include: [base.yaml, power-switch-common.yaml]

properties:
  gpios:
    type: phandle-array
    required: true
    description: GPIO to switch the output on and off

  latching-pgood:
    type: boolean
    description: |
      The switch latches its on state and the GPIO is used as power-good feedback

      The GPIO is driven active for a short time to switch on and configured as an input
      afterwards. The switch pulls the pin to inactive level if it turned off because of a
      fault (e.g. overcurrent).

  charge-pump-pwms:
    type: phandle-array
    specifier-space: pwm
    description: |
      PWM signal for the charge pump of a high-side gate driver

      The PWM runs continuously with 50% duty cycle after initialization.
```

## dts/bindings/power-switch/libresolar,power-switch-emul.yaml
```yaml
# Copyright (c) The Libre Solar Project Contributors
# SPDX-License-Identifier: Apache-2.0

description: |
  Emulated power switch for tests on native_sim

  Supports PWM, power-good feedback and events, which can be injected by the test via
  power_switch_emul.h.

compatible: "libresolar,power-switch-emul"

include: [base.yaml, power-switch-common.yaml]

properties:
  frequency:
    type: int
    description: |
      Emulated PWM frequency in Hz (only informative, no PWM signal is generated)
```

## dts/bindings/power-switch/libresolar,stm32-lptim-power-switch.yaml
```yaml
# Copyright (c) The Libre Solar Project Contributors
# SPDX-License-Identifier: Apache-2.0

description: |
  Power switch with hardware short-circuit protection for STM32L0

  While switched on, the output is driven by LPTIM1, which is triggered by COMP2 and switches
  off the output a few microseconds after a short circuit was detected. The positive comparator
  input is the current measurement, the negative input is 1/4 VREFINT.

  The pinctrl default state must contain the LPTIM1 output on the pin specified in gpios and the
  COMP2 positive input.

  Example:

    load_switch: load-switch {
        compatible = "libresolar,stm32-lptim-power-switch";
        gpios = <&gpiob 2 GPIO_ACTIVE_LOW>;
        pinctrl-0 = <&lptim1_out_pb2 &comp2_inp_pb4>;
        pinctrl-names = "default";
        current-max = <15>;
    };

compatible: "libresolar,stm32-lptim-power-switch"

include: [base.yaml, pinctrl-device.yaml, power-switch-common.yaml]

properties:
  gpios:
    type: phandle-array
    required: true
    description: Output pin used as GPIO while the switch is off

  pinctrl-0:
    required: true

  pinctrl-names:
    required: true
```

## dts/bindings/power-switch/libresolar,stm32-pwm-power-switch.yaml
```yaml
# Copyright (c) The Libre Solar Project Contributors
# SPDX-License-Identifier: Apache-2.0

description: |
  Power switch driven by a PWM signal of an STM32 timer

  The node must be a child of an st,stm32-timers node. The timer is used exclusively by this
  device, as the prescaler and period are determined by the switch frequency. The PWM output is
  active high.

  Example:

    &timers3 {
        status = "okay";

        pwm_switch: pwm-switch {
            compatible = "libresolar,stm32-pwm-power-switch";
            pinctrl-0 = <&tim3_ch4_pb1>;
            pinctrl-names = "default";
            channel = <4>;
            frequency = <50>;
            current-max = <15>;
        };
    };

compatible: "libresolar,stm32-pwm-power-switch"

include: [base.yaml, pinctrl-device.yaml, power-switch-common.yaml]

properties:
  pinctrl-0:
    required: true

  pinctrl-names:
    required: true

  channel:
    type: int
    required: true
    enum: [1, 2, 3, 4]
    description: Timer channel driving the switch

  frequency:
    type: int
    required: true
    description: PWM frequency in Hz
```

## dts/bindings/power-switch/power-switch-common.yaml
```yaml
# Copyright (c) The Libre Solar Project Contributors
# SPDX-License-Identifier: Apache-2.0

description: Common properties for power switches

properties:
  current-max:
    type: int
    description: Maximum continuous current of the switch in amps
```

## dts/bindings/sensor/libresolar,daq-ntc-thermistor.yaml
```yaml
# Copyright (c) The Libre Solar Project Contributors
# SPDX-License-Identifier: Apache-2.0

description: |
  NTC thermistor measured via a DAQ channel

  The NTC is connected between the ADC input and ground with a pull-up resistor to the ADC
  reference voltage. The temperature is calculated using the beta equation.

  Example:

    adc-inputs {
        compatible = "libresolar,stm32-daq";

        daq_temp_fets: temp-fets {
            io-channels = <&adc1 11>;
            multiplier = <1>;
            divider = <1>;
        };
    };

    ntc_fets: ntc-fets {
        compatible = "libresolar,daq-ntc-thermistor";
        daq-channel = <&daq_temp_fets>;
        pullup-ohm = <10000>;
    };

compatible: "libresolar,daq-ntc-thermistor"

include: [sensor-device.yaml]

properties:
  daq-channel:
    type: phandle
    required: true
    description: Child node of the DAQ device measuring the NTC voltage

  pullup-ohm:
    type: int
    required: true
    description: Resistance of the pull-up resistor in ohms

  nominal-ohm:
    type: int
    default: 10000
    description: Resistance of the NTC at 25°C in ohms

  beta:
    type: int
    default: 3435
    description: |
      Beta value of the NTC in kelvin

      The default value is valid for the Semitec 103AT-5 thermistor.
```

## tests/app/testcase.yaml
```yaml
tests:
  app.unit:
    tags:
      - charge_controller
    platform_allow:
      - native_sim
    integration_platforms:
      - native_sim
```

## tests/drivers/daq_ntc/testcase.yaml
```yaml
tests:
  drivers.sensor.daq_ntc:
    tags:
      - drivers
      - sensors
    platform_allow:
      - native_sim
      - native_sim/native/64
    integration_platforms:
      - native_sim
```

## tests/drivers/half_bridge_loopback/testcase.yaml
```yaml
common:
  tags:
    - drivers
    - half_bridge
  platform_allow:
    - nucleo_g474re
  integration_platforms:
    - nucleo_g474re
  harness: ztest
  harness_config:
    # requires the loop-back wiring described in boards/nucleo_g474re.overlay
    fixture: half_bridge_loopback
tests:
  drivers.half_bridge.loopback.advtim:
    extra_args:
      - EXTRA_DTC_OVERLAY_FILE=advtim.overlay
  drivers.half_bridge.loopback.gptim:
    extra_args:
      - EXTRA_DTC_OVERLAY_FILE=gptim.overlay
  drivers.half_bridge.loopback.hrtim:
    extra_args:
      - EXTRA_DTC_OVERLAY_FILE=hrtim.overlay
```

## tests/drivers/power_switch/testcase.yaml
```yaml
tests:
  drivers.power_switch.native_sim:
    tags:
      - drivers
      - power_switch
    platform_allow:
      - native_sim
      - native_sim/native/64
    integration_platforms:
      - native_sim
```

## west.yml
```yaml
manifest:
  remotes:
    - name: zephyrproject
      url-base: https://github.com/zephyrproject-rtos
    - name: thingset
      url-base: https://github.com/ThingSet
  projects:
    - name: zephyr
      remote: zephyrproject
      revision: v4.4-branch
      import:
        name-allowlist:
          - cmsis_6
          - edtt
          - hal_stm32
          - zcbor
    - name: thingset-zephyr-sdk
      remote: thingset
      revision: 8b32f7db1898dc51daa1834b3f8058de6a67166f
      path: thingset-zephyr-sdk
      import:
        name-allowlist:
          - thingset-node-c
          - zcbor
```
